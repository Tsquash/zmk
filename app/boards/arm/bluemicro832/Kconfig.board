## app/boards/arm/bluemicro832/Kconfig.board
```kconfig
# BlueMicro832 board configuration

# Copyright (c) 2020 Pete Johanson, Derek Schmell
# SPDX-License-Identifier: MIT

config BOARD_BLUEMICRO832
	bool "BLUEMICRO832"
	depends on SOC_NRF52832_QFAA
```

## app/boards/arm/bluemicro832/Kconfig.defconfig
```kconfig
# BlueMicro832 board configuration

# Copyright (c) 2020 Pete Johanson, Derek Schmell
# SPDX-License-Identifier: MIT

if BOARD_BLUEMICRO832

config BOARD
	default "bluemicro832"

config BT_CTLR
	default BT

config ZMK_BLE
	default y


endif # BOARD_BLUEMICRO832
```

## app/boards/arm/bluemicro832/bluemicro832_defconfig
```kconfig
# SPDX-License-Identifier: MIT

CONFIG_SOC_SERIES_NRF52X=y
CONFIG_SOC_NRF52832_QFAA=y
CONFIG_BOARD_BLUEMICRO832=y

# Enable MPU
CONFIG_ARM_MPU=y

# enable GPIO
CONFIG_GPIO=y

CONFIG_USE_DT_CODE_PARTITION=y

CONFIG_MPU_ALLOW_FLASH_WRITE=y
CONFIG_NVS=y
CONFIG_SETTINGS_NVS=y
CONFIG_FLASH=y
CONFIG_FLASH_PAGE_LAYOUT=y
CONFIG_FLASH_MAP=y
```

## app/boards/arm/teton/Kconfig.board
```kconfig
# nice!nano board configuration

# Copyright (c) 2020 Pete Johanson
# SPDX-License-Identifier: MIT

config BOARD_TETON
	bool "teton"
	depends on SOC_NRF52840_QIAA
```

## app/boards/shields/twoyo/Kconfig.defconfig
```kconfig
if SHIELD_TWOYO_LEFT

config ZMK_KEYBOARD_NAME
	default "twoyo Left"

config ZMK_SPLIT_BLE_ROLE_CENTRAL
	default y

endif

if SHIELD_TWOYO_RIGHT

config ZMK_KEYBOARD_NAME
	default "twoyo Right"

endif

if SHIELD_TWOYO_LEFT || SHIELD_TWOYO_RIGHT

config ZMK_SPLIT
	default y

endif
```

## app/boards/shields/twoyo/Kconfig.shield
```kconfig
# Copyright (c) 2021 The ZMK Contributers
# SPDX-License-Identifier: MIT

config SHIELD_TWOYO_LEFT
	def_bool $(shields_list_contains,twoyo_left)

config SHIELD_TWOYO_RIGHT
	def_bool $(shields_list_contains,twoyo_right)
```
